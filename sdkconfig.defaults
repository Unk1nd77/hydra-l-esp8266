## sdkconfig.defaults
```kconfig
# ESP8266 Configuration
CONFIG_ESP8266_DEFAULT_CPU_FREQ_80=y
CONFIG_ESP8266_DEFAULT_CPU_FREQ_160=n

# FreeRTOS Configuration
CONFIG_FREERTOS_HZ=100
CONFIG_FREERTOS_UNICORE=y
CONFIG_FREERTOS_CORETIMER_0=y

# WiFi Configuration
CONFIG_ESP8266_WIFI_TX_BUFFER_NUM=16
CONFIG_ESP8266_WIFI_RX_BUFFER_NUM=16
CONFIG_ESP8266_WIFI_RX_BUFFER_SIZE=1600
CONFIG_ESP8266_WIFI_LEFT_CONTINUOUS_RX_BUFFER_NUM=8

# LWIP Configuration
CONFIG_LWIP_MAX_SOCKETS=10
CONFIG_LWIP_SO_REUSE=y
CONFIG_LWIP_SO_RCVBUF=y

# HTTP Server Configuration
CONFIG_HTTPD_MAX_REQ_HDR_LEN=512
CONFIG_HTTPD_MAX_URI_LEN=512

# Partition Table
CONFIG_PARTITION_TABLE_SINGLE_APP=y

# Compiler options
CONFIG_COMPILER_OPTIMIZATION_SIZE=y
CONFIG_COMPILER_CXX_EXCEPTIONS=n
CONFIG_COMPILER_CXX_RTTI=n

# Log output
CONFIG_LOG_DEFAULT_LEVEL_INFO=y
CONFIG_LOG_MAXIMUM_LEVEL=3

# SPIFFS Configuration
CONFIG_SPIFFS_MAX_PARTITIONS=3

# NVS Configuration
CONFIG_NVS_ENCRYPTION=n
```
